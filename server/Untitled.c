/**
 * BasicHTTPClientPostUpload.ino
 *
 * See http://posttestserver.com/ for the HTTP server details.
 *
 * Use HTTP multipart form-data to upload a 256 byte file.
 *
 * References:
 *  https://tools.ietf.org/html/rfc7230
 *  https://tools.ietf.org/html/rfc7231
 */

#include <ESP8266WiFi.h>
#include <ESP8266WiFiMulti.h>

#include <ESP8266HTTPClient.h>

const uint8_t PROGMEM Post_Data[] = {
0x00,0x01,0x02,0x03,0x04,0x05,0x06,0x07,0x08,0x09,0x0a,0x0b,0x0c,0x0d,0x0e,0x0f,
0x10,0x11,0x12,0x13,0x14,0x15,0x16,0x17,0x18,0x19,0x1a,0x1b,0x1c,0x1d,0x1e,0x1f,
0x20,0x21,0x22,0x23,0x24,0x25,0x26,0x27,0x28,0x29,0x2a,0x2b,0x2c,0x2d,0x2e,0x2f,
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0xf0,0xf1,0xf2,0xf3,0xf4,0xf5,0xf6,0xf7,0xf8,0xf9,0xfa,0xfb,0xfc,0xfd,0xfe,0xff
};

const char PROGMEM CONTENT_HEADERS[] =
"\r\nContent-Disposition: form-data; name=\"testfile\"; filename=\"data.bin\"\r\n"
"Content-Type: application/octet\r\n\r\n";

#define USE_SERIAL Serial

ESP8266WiFiMulti WiFiMulti;

void setup() {
  USE_SERIAL.begin(115200);
  // USE_SERIAL.setDebugOutput(true);

  USE_SERIAL.println();
  USE_SERIAL.println();
  USE_SERIAL.println();

  for(uint8_t t = 4; t > 0; t--) {
    USE_SERIAL.printf("[SETUP] WAIT %d...\n", t);
    USE_SERIAL.flush();
    delay(1000);
  }

  WiFiMulti.addAP("SSID", "password");
}

void loop() {
  // wait for WiFi connection
  if((WiFiMulti.run() == WL_CONNECTED)) {

    HTTPClient http;
    int httpCode;

    char body[2048];
    char boundary[32] = "----";

    randomSeed(micros() + analogRead(A0));
    for (int i = 0; i < 3; i++) {
      ltoa(random(0x7FFFFFF), boundary + strlen(boundary), 16);
    }

    USE_SERIAL.print("[HTTP] begin...\n");
    // Use posttestserver.com
    http.begin("http://posttestserver.com/post.php");
    strcpy(body, "multipart/form-data; boundary=");
    strcat(body, &boundary[2]);
    USE_SERIAL.printf("[HTTP] Content-Type: %s\n", body);
    http.addHeader("Content-Type", body, false, true);

    // WARNING: Make sure body[] is big enough to hold the post data and
    // headers.
    strcpy(body, boundary);
    strcat_P(body, CONTENT_HEADERS);
    int content_length = strlen(body);
    // Append binary post data to headers. Note binary data may include '\0'
    // so C string functions can no longer be used on this buffer.
    memcpy_P(body+content_length, Post_Data, sizeof(Post_Data));
    content_length += sizeof(Post_Data);
    memcpy(body+content_length, "\r\n", 2);
    content_length += 2;
    memcpy(body+content_length, boundary, strlen(boundary));
    content_length += strlen(boundary);
    memcpy(body+content_length, "--\r\n", 4);
    content_length += 4;

    USE_SERIAL.printf("[HTTP] POST...%d\n", content_length);
    // start connection and send multipart/form-data
    httpCode = http.POST((uint8_t*)body, content_length);

    // httpCode will be negative on error
    if(httpCode > 0) {
      // HTTP header has been send and Server response header has been handled
      USE_SERIAL.printf("[HTTP] POST... code: %d\n", httpCode);

      // file found at server
      if(httpCode == HTTP_CODE_OK) {
        String payload = http.getString();
        USE_SERIAL.println(payload);
      }
    } else {
      USE_SERIAL.printf("[HTTP] POST... failed, error: %s\n", http.errorToString(httpCode).c_str());
    }

    http.end();
  }

  delay(10000);
}
